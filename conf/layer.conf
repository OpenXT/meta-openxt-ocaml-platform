## conf/layer.conf
```bitbake
# We have a conf and classes directory, append to BBPATH
BBPATH .= ":${LAYERDIR}"

# We have a recipes directory, add to BBFILES
BBFILES += " \
    ${LAYERDIR}/recipes-*/*/*.bb \
    ${LAYERDIR}/recipes-*/*/*.bbappend \
    ${LAYERDIR}/recipes-*/*/*/*.bb \
    ${LAYERDIR}/recipes-*/*/*/*.bbappend \
"

BBFILE_COLLECTIONS += "meta-openxt-ocaml-platform"
BBFILE_PATTERN_meta-openxt-ocaml-platform := "^${LAYERDIR}/"
BBFILE_PRIORITY_meta-openxt-ocaml-platform = "8"

LAYERVERSION_meta-openxt-ocaml-platform = "2"
LAYERSERIES_COMPAT_meta-openxt-ocaml-platform = "dunfell"
```
